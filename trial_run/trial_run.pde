import processing.video.*;
import java.util.Iterator;
import processing.serial.*;  // import the Processing serial library

// define limits of flex sensors
final int wristMin1 = 60;
final int wristMax1 = 117;

final int wristMin2 = 60;
final int wristMax2 = 120;

final int elbowMin1 = 30;
final int elbowMax1 = 50;

final int elbowMin2 = 45;
final int elbowMax2 = 115;

final int armpitMin1 = 77;
final int armpitMax1 = 110;

final int armpitMin2 = 72;
final int armpitMax2 = 107;

// values generated by the sensors
int wrist1, wrist2;
int elbow1, elbow2;
int armpit1, armpit2;

Serial myPort1;                // the serial port
boolean firstContact = false;  // used in the handshake methods

Movie theMovLeft, theMovRight;

void setup() {
  size(1000, 600);
  String portName1 = "COM4";
  myPort1 = new Serial(this, portName1, 9600);
  // read incoming bytes to a buffer until you get a linefeed (ASCII 10)
  myPort1.bufferUntil('\n');
  theMovLeft= new Movie(this, "VID_LEFT_3.mov");
  theMovRight = new Movie(this, "VID_RIGHT_3.mov");
  theMovLeft.play();
  theMovRight.play();  
}

void draw() { 
  // play the left and right video
  image(theMovLeft, 0, 0);
  image(theMovRight, width/2, 0);
  
  // draw line to divide the screen into two
  strokeWeight(20);
  line(width/2, 0, width/2, height);
  strokeWeight(1);

  // draw the sliders
  strokeWeight(10);
  stroke(255, 0, 0);
  // left side
  line(10, height/4, width/2-20, height/4);
  if (wrist1 < 10) {
    wrist1 = 10;
  } else if (wrist1 > width/2-20) {
    wrist1 = width/2-20;
  }
  line(wrist1, height/4-30, wrist1, height/4);

  line(10, height/2, width/2-20, height/2);
  if (elbow1 < 10) {
    elbow1 = 10;
  } else if (elbow1 > width/2-20) {
    elbow1 = width/2-20;
  }
  line(elbow1, height/2-30, elbow1, height/2);

  line(10, height*.75, width/2-20, height*.75);
  if (armpit1 < 10) {
    armpit1 = 10;
  } else if (armpit1 > width/2-20) {
    armpit1 = width/2-20;
  }
  line(armpit1, height*.75-30, armpit1, height*.75);

  line(width/2+20, height/4, width-10, height/4);
  if (wrist2 < width/2+20) {
    wrist2 = width/2+20;
  } else if (wrist2 > width-10) {
    wrist2 = width-10;
  }
  line(wrist2, height/4-30, wrist2, height/4);

  line(width/2+20, height/2, width-10, height/2);
  if (elbow2 < width/2+20) {
    elbow2 = width/2+20;
  } else if (elbow2 > width-10) {
    elbow2 = width-10;
  }
  line(elbow2, height/2-30, elbow2, height/2);

  line(width/2+20, height*.75, width-10, height*.75);
  if (armpit2 < width/2+20) {
    armpit2 = width/2+20;
  } else if (armpit2 > width-10) {
    armpit2 = width-10;
  }
  line(armpit2, height*.75-30, armpit2, height*.75);

  delay(1);
}

void movieEvent(Movie m) {
  m.read();
}

void serialEvent(Serial thisPort) {
  // read the serial buffer  
  String myString = thisPort.readStringUntil('\n');
  if (myString != null) {
    myString = trim(myString);

    // if you haven't heard from the microcontroller yet, listen
    if (firstContact == false) {
      if (myString.equals("hello")) {
        thisPort.clear();        // clear the serial port buffer
        firstContact = true;   // you've had first contact from the microcontroller
        thisPort.write('A');     // ask for more
      }
    }
    // if you have heard from the microcontroller, proceed
    else {
      // split the string at the commas and convert the sections into integers
      int sensors[] = int(split(myString, ','));

      if (sensors.length > 1) {
        //println(sensors[0]);
        wrist1 = (int)map(sensors[0], wristMin1, wristMax1, 10, width/2-20);
        elbow1 = (int)map(sensors[1], elbowMin1, elbowMax1, 10, width/2-20);
        armpit1 = (int)map(sensors[2], armpitMin1, armpitMax1, 10, width/2-20);
        wrist2 = (int)map(sensors[3], wristMin2, wristMax2, width/2+20, width-20);
        elbow2 = (int)map(sensors[4], elbowMin2, elbowMax2, width/2+20, width-20);
        armpit2 = (int)map(sensors[5], armpitMin2, armpitMax2, width/2+20, width-20);
      }
    }
    // when you've parsed the data you have, ask for more
    // this is part of the handshake method
    thisPort.write("A");
  }
}
